## device/components/meshvpn_board/Kconfig
```kconfig
menu "meshvpn Board"

    choice MESHVPN_BOARD
        prompt "Target board"
        default MESHVPN_BOARD_XIAO_ESP32S3

        config MESHVPN_BOARD_XIAO_ESP32S3
            bool "Seeed XIAO ESP32-S3"

        config MESHVPN_BOARD_M5_STAMP_P4_C6
            bool "M5Stack Stamp-P4 + C6 addon (scaffold)"
    endchoice

endmenu

menu "meshvpn USB"

    config MESHVPN_USB_SUBNET_OCTET_2
        int "USB host LAN third octet (192.168.X.0/24)"
        range 1 254
        default 7
        help
            USB-side LAN for connected host. Default 7 → 192.168.7.0/24
            (compatible with clean-vpn --client-lan-subnet).

    choice MESHVPN_USB_PROFILE
        prompt "USB network class"
        default MESHVPN_USB_PROFILE_NCM
        help
            Selected by profiles/usb_*.defconfig via ./device/scripts/flash.sh.

        config MESHVPN_USB_PROFILE_NCM
            bool "CDC-NCM (iPhone USB-C, modern macOS)"

        config MESHVPN_USB_PROFILE_RNDIS
            bool "RNDIS (Windows)"

        config MESHVPN_USB_PROFILE_ECM
            bool "CDC-ECM (Linux, legacy macOS)"
    endchoice

endmenu

menu "meshvpn WiFi"

    config MESHVPN_WIFI_HIGH_SPEED
        bool "Prefer 802.11n/HT40 high-speed mode"
        default y
        help
            Limit the radio to 802.11g/n (no legacy 802.11b) and request HT40
            on STA and SoftAP. This can improve throughput but may reduce
            compatibility with old access points or clients. The connected
            router still decides the actual channel width and PHY rate.

endmenu

menu "meshvpn Web"

    config MESHVPN_WEB_HTTPS
        bool "Enable HTTPS administration by default"
        default n
        help
            Initial mode when no HTTPS preference is saved in NVS. Both HTTP
            and HTTPS are built in; the admin checkbox overrides this default
            after reboot, without reflashing. HTTP credentials are unencrypted.

    config MESHVPN_WEB_REQUIRE_PASSWORD_CHANGE
        bool "Require changing the default admin password"
        default n
        help
            When enabled, a session using the default admin password may view
            status/logs and scan WiFi, but must change the password before
            changing configuration. Disabled for development/testing.

    config MESHVPN_WEB_ADMIN_PASSWORD_DEFAULT
        string "Default web admin password"
        default "admin"

endmenu
```

## device/components/meshvpn_profiled_tls/Kconfig
```kconfig
menu "Profiled TLS backend (experimental)"
    config MESHVPN_PROFILED_TLS_ENABLE
        bool "Build isolated profiled TLS backend"
        default n
        depends on SPIRAM && (IDF_TARGET_ESP32S3 || IDF_TARGET_ESP32P4)
        select FREERTOS_TASK_CREATE_ALLOW_EXT_MEM
        help
            Compile the frozen-profile backend and its dedicated PSRAM executor.
            Enables boring-tls in the VPN selector (TLS 1.3 + HTTP/1.1 Bearer v2). Requires pinned
            prepared BoringSSL/Brotli sources; see experiments/profiled-tls.
    config MESHVPN_PROFILED_TLS_P4_GCM
        bool "Use ESP-IDF AES-GCM record backend on P4"
        depends on MESHVPN_PROFILED_TLS_ENABLE && IDF_TARGET_ESP32P4 && MBEDTLS_HARDWARE_GCM
        default n
        help
            Uses a bounded temporary internal DMA slab per AES-GCM record.
            Keeps BoringSSL TLS nonce, certificate and profile checks unchanged.
    config MESHVPN_PROFILED_TLS_STACK_BYTES
        int "Profiled TLS executor stack bytes"
        depends on MESHVPN_PROFILED_TLS_ENABLE
        range 32768 65536
        default 32768
        help
            Separate lazy PSRAM stack. ML-KEM nested frames exceed 8 KiB before
            TLS/RTOS overhead. Actual high-water still needs hardware validation.
endmenu
```

## device/components/meshvpn_routing/Kconfig
```kconfig
menu "meshvpn Routing"

    config MESHVPN_ROUTING_MAX_RULES
        int "Maximum routing rules"
        default 32

    config MESHVPN_ROUTING_MAX_DOMAINS
        int "Maximum domain rules"
        default 64

endmenu
```

## device/components/meshvpn_storage/Kconfig
```kconfig
menu "meshvpn storage"

    config MESHVPN_STORAGE_EMBED_TEST_CERTS
        bool "Embed default CA + HMAC key + browser profile for lab testing"
        default y
        help
            On first boot, copy embedded test CA, clean-vpn-hmac.key and
            profiles/browser.json into SPIFFS when missing. Admin upload still
            overwrites them.

endmenu
```

## device/components/meshvpn_vpn/Kconfig
```kconfig
menu "meshvpn VPN"

    config MESHVPN_VPN_ENABLE
        bool "Enable VPN client (experimental)"
        default y
        help
            Experimental unencrypted TCP and UDP tunnels to clean-vpn exit.
            Disabled at runtime until explicitly configured. TLS is not implemented.

    config MESHVPN_VPN_TX_BATCH_FRAMES
        int "TCP tunnel TX batch frames"
        range 1 64
        default 32
        help
            Maximum number of IPv4 frames coalesced into one outer TCP write.
            Larger values reduce write and wakeup overhead at the cost of queue
            latency. Set 16 for the previous baseline.

    config MESHVPN_VPN_UDP_RX_BATCH_FRAMES
        int "UDP tunnel RX batch frames"
        range 1 64
        default 32
        help
            Maximum number of already queued UDP datagrams injected into lwIP
            in one bounded batch. Larger values amortize tcpip-thread dispatch.

    config MESHVPN_VPN_UDP_RX_BATCH_US
        int "UDP tunnel RX batch budget (microseconds)"
        range 250 10000
        default 4000
        help
            Time budget for draining one UDP RX batch. This is a bound, not a
            deliberate delay; the drain stops earlier when the socket is empty.
            Use 2000 for the previous baseline.

endmenu
```

## device/main/Kconfig.projbuild
```kconfig
menu "MeshPN diagnostic firmware"
config MESHVPN_DWC2_TELEMETRY
    bool "Experimental NCM DWC2 ISR and FIFO telemetry"
    depends on IDF_TARGET_ESP32S3 && MESHVPN_NCM_TELEMETRY
    default n
    help
        Read FIFO registers in the DCD, count FIFO writes, and time transfer
        submission to ISR completion and ISR to NCM callback. Adds overhead
        per FIFO refill; disable for a throughput baseline. No payload logs.

config MESHVPN_USB_NCM_DOUBLE_BUFFER
    bool "Experimental double hardware FIFO for NCM bulk IN"
    depends on IDF_TARGET_ESP32S3 && TINYUSB_NET_MODE_NCM
    depends on !TINYUSB_MSC_ENABLED && TINYUSB_CDC_COUNT <= 1 && TINYUSB_VENDOR_COUNT = 0
    default n
    help
        Configure the TinyUSB DWC2 controller before initialization to hold
        two 64-byte packets on the network IN endpoint (64 extra FIFO bytes).
        Does not enlarge frame queues, NTB pools or change event waits.
        Uses the default esp_tinyusb FS descriptor, as installed by iot_bridge.
        Disable to compare with the single-FIFO baseline.

config MESHVPN_USB_TX_EVENT_WAIT
    bool "Wait for NCM completion in the USB TX worker"
    depends on MESHVPN_USB_TX_QUEUE && MESHVPN_NCM_TELEMETRY
    default n
    help
        Replace rapid busy retries with task notifications after NCM IN
        completion. Capacity retry budget is 25ms; queue size is unchanged by
        this option.
        Only the worker waits. Disable to compare with the yield baseline.

config MESHVPN_USB_TX_QUEUE
    bool "Experimental bounded USB TX worker queue"
    depends on SPIRAM && !TINYUSB_MSC_ENABLED
    default n
    help
        Eight owned frame buffers in PSRAM, a 3KiB internal task stack and
        nonblocking lwIP enqueue. Sync fallback on allocation/task failure.
        Disable for comparison with the previous synchronous transport.

config MESHVPN_NCM_TELEMETRY
    bool "Passive NCM pool and transfer telemetry"
    depends on TINYUSB_NET_MODE_NCM
    default n
    help
        Instruments a build-directory copy of the pinned TinyUSB NCM driver.
        Measures pool occupancy and submit-to-callback time in TinyUSB task
        context. No payload logging or extra USB requests. Disable to measure
        instrumentation overhead; unavailable is reported instead of zeros.

config MESHVPN_USB_DIAGNOSTICS
    bool "Read-only diagnostic snapshots over the existing USB CDC interface"
    depends on TINYUSB_CDC_ENABLED
    default n
    help
        Allows the physically attached USB host to read buffered logs without
        admin authentication. No commands can modify settings or reboot.
        Debug only: disable for performance measurements and normal use.
endmenu
```

## device/profiles/profiled_tls.defconfig
```kconfig
CONFIG_MESHVPN_PROFILED_TLS_ENABLE=y
CONFIG_MESHVPN_PROFILED_TLS_STACK_BYTES=32768
CONFIG_FREERTOS_TASK_CREATE_ALLOW_EXT_MEM=y
```

## device/profiles/usb_rndis.defconfig
```kconfig
# USB RNDIS — Windows

CONFIG_TINYUSB_DEBUG_LEVEL=0
CONFIG_TINYUSB_NET_MODE_ECM_RNDIS=y
CONFIG_TINYUSB_NET_RNDIS=y
CONFIG_MESHVPN_USB_PROFILE_RNDIS=y
```
